## configs/zicbox_defconfig
```kconfig
BR2_arm=y
BR2_cortex_a72=y
BR2_TOOLCHAIN_BUILDROOT_GLIBC=y
BR2_PACKAGE_HOST_LINUX_HEADERS_CUSTOM_6_1=y

BR2_TARGET_GENERIC_GETTY_PORT="tty1"
BR2_SYSTEM_DHCP="eth0 wlan0"
BR2_ROOTFS_OVERLAY="board/zicbox/overlay"

BR2_LINUX_KERNEL=y
BR2_LINUX_KERNEL_CUSTOM_VERSION=y
BR2_LINUX_KERNEL_CUSTOM_VERSION_VALUE="6.1.77"
BR2_LINUX_KERNEL_USE_CUSTOM_CONFIG=y
BR2_LINUX_KERNEL_CUSTOM_CONFIG_FILE="board/zicbox/linux.config"
BR2_LINUX_KERNEL_DTS_SUPPORT=y
BR2_LINUX_KERNEL_INTREE_DTS_NAME="broadcom/bcm2711-rpi-cm4"

BR2_PACKAGE_DROPBEAR=y
BR2_PACKAGE_DROPBEAR_DISABLE_PATH=y
BR2_PACKAGE_WPA_SUPPLICANT=y
BR2_PACKAGE_WPA_SUPPLICANT_AUTOMATIC_SCAN=y

BR2_PACKAGE_OPKG=y

BR2_PACKAGE_PULSEAUDIO=y
BR2_PACKAGE_ALSA_UTILS=y

BR2_PACKAGE_BUSYBOX_SHOW_OTHERS=y

BR2_TARGET_ROOTFS_EXT2=y
BR2_TARGET_ROOTFS_EXT2_4=y
BR2_TARGET_ROOTFS_EXT2_SIZE="256M"
BR2_TARGET_ROOTFS_TAR=y

BR2_PACKAGE_HOST_SCP=y
```

## zicbox_defconfig
```kconfig
BR2_aarch64=y
BR2_cortex_a72=y
BR2_ARM_FPU_VFPV4=y
BR2_PACKAGE_HOST_LINUX_HEADERS_CUSTOM_6_6=y
BR2_TOOLCHAIN_BUILDROOT_CXX=y
BR2_GLOBAL_PATCH_DIR="board/raspberrypi/patches"
BR2_DOWNLOAD_FORCE_CHECK_HASHES=y
BR2_SYSTEM_DHCP="eth0 wlan0"
BR2_ROOTFS_POST_BUILD_SCRIPT="board/raspberrypi4-64/post-build.sh"
BR2_ROOTFS_POST_IMAGE_SCRIPT="board/raspberrypi4-64/post-image.sh"
BR2_LINUX_KERNEL=y
BR2_LINUX_KERNEL_CUSTOM_TARBALL=y
BR2_LINUX_KERNEL_CUSTOM_TARBALL_LOCATION="$(call github,raspberrypi,linux,576cc10e1ed50a9eacffc7a05c796051d7343ea4)/linux-576cc10e1ed50a9eacffc7a05c796051d7343ea4.tar.gz"
BR2_LINUX_KERNEL_DEFCONFIG="bcm2711"
BR2_LINUX_KERNEL_DTS_SUPPORT=y
BR2_LINUX_KERNEL_INTREE_DTS_NAME="broadcom/bcm2711-rpi-4-b broadcom/bcm2711-rpi-400 broadcom/bcm2711-rpi-cm4 broadcom/bcm2711-rpi-cm4s"
BR2_LINUX_KERNEL_NEEDS_HOST_OPENSSL=y
BR2_PACKAGE_BUSYBOX_SHOW_OTHERS=y
BR2_PACKAGE_XZ=y
BR2_PACKAGE_RPI_FIRMWARE=y
BR2_PACKAGE_RPI_FIRMWARE_VARIANT_PI4=y
BR2_PACKAGE_RPI_FIRMWARE_CONFIG_FILE="board/raspberrypi4-64/config_4_64bit.txt"
BR2_PACKAGE_KMOD=y
BR2_PACKAGE_KMOD_TOOLS=y
BR2_TARGET_ROOTFS_EXT2=y
BR2_TARGET_ROOTFS_EXT2_4=y
BR2_TARGET_ROOTFS_EXT2_SIZE="120M"
# BR2_TARGET_ROOTFS_TAR is not set
BR2_PACKAGE_HOST_DOSFSTOOLS=y
BR2_PACKAGE_HOST_GENIMAGE=y
BR2_PACKAGE_HOST_KMOD_XZ=y
BR2_PACKAGE_HOST_MTOOLS=y

# Networking
BR2_PACKAGE_WPA_SUPPLICANT=y
BR2_PACKAGE_WPA_SUPPLICANT_AUTOMATIC_SCAN=y

# SSH
BR2_PACKAGE_DROPBEAR=y
BR2_PACKAGE_DROPBEAR_DISABLE_PATH=y
BR2_TARGET_GENERIC_ROOT_PASSWD="password"

# Package management
BR2_PACKAGE_OPKG=y

# Audio (optional, if needed)
BR2_PACKAGE_PULSEAUDIO=y
BR2_PACKAGE_ALSA_UTILS=y

# Host utilities
BR2_PACKAGE_HOST_SCP=y

#dev tools
BR2_PACKAGE_GCC=y
BR2_PACKAGE_GXX=y
BR2_PACKAGE_BINUTILS=y
BR2_PACKAGE_MAKE=y
BR2_PACKAGE_CMAKE=y
BR2_PACKAGE_PKGCONF=y
BR2_PACKAGE_GDB=y
BR2_PACKAGE_GIT=y
BR2_PACKAGE_VIM_TINY=y

BR2_PACKAGE_LIBBCM2835=y

BR2_PACKAGE_LIBSNDFILE=y
BR2_PACKAGE_LIBRTMIDI=y
BR2_PACKAGE_NLOHMANN_JSON=y
BR2_PACKAGE_FREETYPE=y

# custom overlay
BR2_ROOTFS_OVERLAY="../overlay"

# custom config
BR2_PACKAGE_RPI_FIRMWARE_CONFIG_FILE="../linux.conf"

# post build script: this will run after the rootfs is built on the build machine and not the target
# BR2_ROOTFS_POST_BUILD_SCRIPT="../post-build.sh"

# gen img file
BR2_TARGET_ROOTFS_SDIMAGE=y
BR2_TARGET_ROOTFS_GENIMAGE=y
BR2_TARGET_ROOTFS_GENIMAGE_CONFIG="../genimage.cfg"

BR2_TARGET_ROOTFS_VFAT=y
BR2_TARGET_ROOTFS_VFAT_SIZE="256M"
```
